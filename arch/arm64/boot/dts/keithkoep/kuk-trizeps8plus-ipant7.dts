/*
 * Copyright 2020 Keith & Koep GmbH
 *
 */

/dts-v1/;

// Add defines here, which control behaviour of .dtsi:
#define display_enable &gpio1 5
#define USDHC_MHZ 100

#include "trizeps8plus.dtsi"
#include "ipant7-tr8p.dtsi"
#include "atm0700-tr8p.dtsi"

/ {
	model      = "Keith & Koep GmbH iPANT7 i.MX8MP Trizeps8-Plus";
	compatible = "kk,trizeps8", "kk,trizeps8mini", "kk,trizeps8plus", "fsl,imx8mp-evk", "fsl,imx8mp";

};

&lcdif1 {
	status = "okay";
};
