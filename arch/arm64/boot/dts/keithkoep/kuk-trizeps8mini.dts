/*
 * Copyright 2020 Keith & Koep GmbH
 *
 */

/dts-v1/;

// Add defines here, which control behaviour of .dtsi:

#include "trizeps8miniX.dtsi"

/ {
	model      = "Keith & Koep GmbH pConXS V3 ATM0700L61CT i.MX8MM Trizeps8-Mini";
	compatible = "kk,trizeps8", "kk,trizeps8mini", "fsl,imx8mm-evk", "fsl,imx8mm";
    
	chosen {
		stdout-path = &uart1;
	};
};








