/*
 * Copyright 2020 Keith & Koep GmbH
 *
 */

/dts-v1/;

// Add defines here, which control behaviour of .dtsi:
#define ETHERNET_ONLY_100MBIT       0

#include "trizeps8.dtsi"
#include "ipant7.dtsi"
#include "atm0700.dtsi"

/ {
	model      = "Keith & Koep GmbH iPANT7 i.MX8MQ Trizeps8";
	compatible = "kk,trizeps8", "kk,trizeps8mini", "fsl,imx8mq-evk", "fsl,imx8mq";

	chosen {
		stdout-path = &uart1;
	};
};








